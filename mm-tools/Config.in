## mm-tools/Config.in
```kconfig
menu "Configuration"
depends on PACKAGE_mm-tools

config MM_TOOLS_SOFT_CRC
	bool "enable soft crc algorithm"
	default y

config MM_TOOLS_FLASH_LAYOUT_2M
	bool "enable flash layout 2m"
	default y

endmenu
```
